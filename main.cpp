#include "mbed.h"
#include "Speaker.h"
#include "PinDetect.h"
#include "TextLCD.h"
#include "Shiftbrite.h"
#include "TMP36.h"

//declare object for LCD
TextLCD lcd(p22, p23, p24, p25, p26, p27);//rs, e, d4-d7

// use class to setup temperature sensor pins
TMP36 myTMP36(p15);  //Analog in

//declare object and setup pins for shiftbrite
Shiftbrite myShiftbrite(p9, p10, p11, p12, p13);// ei li di n/c ci

// use class to setup Mbed's four on-board LEDs
DigitalOut myLED1(LED1);
DigitalOut myLED2(LED2);
DigitalOut myLED3(LED3);
DigitalOut myLED4(LED4);

//declare objects for pins used with pushbuttons
PinDetect pb1(p28);
PinDetect pb2(p29);
PinDetect pb3(p30);

//declare a speaker object
Speaker mySpeaker(p21);

//also setting any unused analog input pins to digital outputs reduces A/D noise a bit
//see http://mbed.org/users/chris/notebook/Getting-best-ADC-performance/
DigitalOut P16(p16);
DigitalOut P17(p17);
DigitalOut P18(p18);
DigitalOut P19(p19);
DigitalOut P20(p20);
DigitalOut P14(p14);
DigitalOut P5(p5);
DigitalOut P6(p6);
DigitalOut P7(p7);
DigitalOut P8(p8);

//enum InputType {set_point= 78};
enum StateType {HEAT_OFF, HEAT_ON, COOL_OFF, COOL_ON, OFF};
//enum ModeType {Heat, Cool, Off};
//InputType input = set_point;

StateType state = OFF;
//ModeType status = Off; 
// Global variables used in callbacks and main program
// C variables in interrupt routines should use volatile keyword
int volatile heat_setting=78; // heat to temp
int volatile cool_setting=68; // cool to temp
int volatile mode=0; // heat or cool mpde

//Callback routines based on interrupts generated by pushbutton events 
//Callback routine is interrupt activated by a debounced pb1 hit
void pb1_hit_callback(void)
{
// ADD CODE HERE THAT YOU WANT TO RUN WHEN INTERRUPT IS GENERATED
if (mode==1)
{
heat_setting++;
lcd.locate(11,1);
if (state == HEAT_OFF){
lcd.locate(14,1);}
lcd.printf("%2d",heat_setting);
mySpeaker.PlayNote(300.0,0.10,0.1);
}

if (mode==2)
{
cool_setting++;
lcd.locate(11,1);
if (state == COOL_OFF){
lcd.locate(14,1);}
lcd.printf("%2d",cool_setting);
mySpeaker.PlayNote(300.0,0.10,0.1);
}
} 

//Callback tourine is interrupt activated by a debounced pb2 hit
void pb2_hit_callback(void)
{
if (mode ==1)
{
heat_setting--;
lcd.locate(11,1);
if (state == HEAT_OFF){
lcd.locate(14,1);}
lcd.printf("%2d",heat_setting);
mySpeaker.PlayNote(200.0,0.10,0.1);
}
if (mode==2)
{
cool_setting--;
lcd.locate(11,1);
if (state ==COOL_OFF){
lcd.locate(14,1);}
lcd.printf("%2d",cool_setting);
mySpeaker.PlayNote(200.0,0.10,0.1);
}
}

//Callback routine is interrupt activated by a debounced pb3 hit
void pb3_hit_callback(void)
{
mode = (mode +1) % 3; //cycle forward by 1
//mySpeaker.PlayNote(700.0, 0.25, 0.01);
if (mode==0){
state = OFF;
mySpeaker.PlayNote(500.0, 0.15, 0.1);}
if (mode==1){
state = HEAT_OFF;
mySpeaker.PlayNote(700.0, 0.15, 0.1);}
if (mode==2){
state = COOL_OFF;
mySpeaker.PlayNote(600.0, 0.15, 0.1);}
}
int red =0;
int blue=0;
int green = 0;
int flag =0; //flag to decide when past state will be saved


int main() {
 //float Current_temp=0.0;
 float tempF = 0.0; 

pb1.mode(PullUp);
pb2.mode(PullUp);
pb3.mode(PullUp);

//Delay for initial pullup to take effect
wait(.01);

//Setup Interrupt callback functions for a pb hit
pb1.attach_deasserted(&pb1_hit_callback);
pb2.attach_deasserted(&pb2_hit_callback);
pb3.attach_deasserted(&pb3_hit_callback);

//Start sampling pb inputs using interrupts
pb1.setSampleFrequency(); //default is 20KHz sampling
pb2.setSampleFrequency(); 
pb3.setSampleFrequency();
//pushbuttons now setup and running

while(1){
 tempF=(9.0 * myTMP36.read())/5.0 + 32.0;
 flag++;
 StateType sudo;// state type to hold past state
if ((flag % 2)==1){  //sudo will equal save state every other cycle
 sudo = state;}
    switch(state)
    {
    
    case(HEAT_OFF):
    //Produce output for this state
    if (sudo != HEAT_OFF){                   //note will play when last state is not equal current or every change of state
     mySpeaker.PlayNote(161.0,0.25,0.01);}
    myLED3=0;
    myLED1=1;
    myLED2=0;
    myLED4=0;
    lcd.cls();
    lcd.printf("TEMP=%2.0FF HEAT\n",tempF);
    lcd.locate(0,1);
    lcd.printf("Holding above %2d\n", heat_setting);
    //calculate next state
    if (tempF < heat_setting)
       state = HEAT_ON;
     if(mode==0)
     state= OFF;
       break;
       
     case(HEAT_ON):
     //Produce output for this state
     if (sudo != HEAT_ON){                   //note will play when last state is not equal current or every change of state
     mySpeaker.PlayNote(261.0,0.25,0.01);}
     myLED3=1;
     myLED1=1;
     myLED2=0;
     myLED4=0;
     red= 50;
     green =0;
     blue =0;
     myShiftbrite.write(red, green, blue);
     lcd.cls();
     lcd.printf("TEMP=%2.0FF HEAT\n", tempF);
     lcd.locate(0,1);
     lcd.printf("Heating to %2d \n", heat_setting);
     if (tempF >= heat_setting) //input is 78
        state = HEAT_OFF;
        break;
        
      case(COOL_OFF):
      if (sudo != COOL_OFF){                   //note will play when last state is not equal current or every change of state
     mySpeaker.PlayNote(161.0,0.25,0.01);}
      myLED4=0;
      myLED1=0;
      myLED2=1;
      myLED3=0;
      lcd.cls();
      lcd.printf("TEMP=%2.0FF COOL\n", tempF);
      lcd.locate(0,1);
      lcd.printf("Holding below %2d\n", cool_setting);
      if (tempF > cool_setting)
         state = COOL_ON;
        if (mode==0)
         state = OFF;
         break;
         
       case(COOL_ON):
       if (sudo != COOL_ON){                   //note will play when last state is not equal current or every change of state
     mySpeaker.PlayNote(261.0,0.25,0.01);}
      myLED4=1;
      myLED1=0;
      myLED2=1;
      myLED3=0;
      myShiftbrite.write(0,0,50);
      lcd.cls();
      lcd.printf("TEMP=%2.0FF COOL\n", tempF);
      lcd.locate(0,1);
      lcd.printf("Cooling to %2d\n", cool_setting);
      if (tempF <= cool_setting )
         state = COOL_OFF;
         break;
         
       case(OFF):
       myLED1= 0;
       myLED2=0;
       myLED3=0;
       myLED4=0;
       lcd.cls();
       lcd.printf("TEMP= %2.0FF OFF\n", tempF);
       if (mode==1)
       state = HEAT_OFF;
       if(mode==2)
       state= COOL_OFF;
       if (mode==0)
       state= OFF;
       break;
            
         }//end switch
         //sudo = state;
         wait (0.33);
       }
     }